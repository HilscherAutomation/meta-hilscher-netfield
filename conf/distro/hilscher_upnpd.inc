## conf/distro/hilscher_upnpd.inc
```bitbake
MANUFACTURER:pn-upnpd-conf              = "Hilscher Gesellschaft fuer Systemautomation mbH"
MANUFACTURER_URL:pn-upnpd-conf          = "https://www.hilscher.com"
MODEL_URL:pn-upnpd-conf                 = "https://www.hilscher.com"
```

## conf/distro/include/sanity.inc
```bitbake
SANITY_TESTED_DISTROS = " \
            ubuntu-18.04 \n \
            ubuntu-22.04 \n \
            "
CONNECTIVITY_CHECK_URIS = "https://www.hilscher.com/"
```

## conf/machine/hilscher-machine-vars.conf
```bitbake
# https://kb.hilscher.com/pages/viewpage.action?spaceKey=NETXSYS&title=File+system+layout

# --------------------------------------
PLATFORM_SIGN ??= "0"
PLATFORM_KEYDIR ??= ""
PLATFORM_KEYNAME ??= ""

# --------------------------------------
INITRAMFS_IMAGE ?= "core-image-minimal-initramfs"
# NOTE: INITRAMFS_IMAGE_NAME is defined in kernel.bbclass so we have to define it here as well
#       to be able to reference it in other recipes (which do not inherit the class).
INITRAMFS_IMAGE_NAME ?= "${@['${INITRAMFS_IMAGE}-${MACHINE}', ''][d.getVar('INITRAMFS_IMAGE') == '']}"

# --------------------------------------
IMAGE_CLASSES_append += "hilscher_image_types"
IMAGE_FSTYPES += "wic.bz2 swu licenses.tar.bz2"

# --------------------------------------
PART_SCHEME ??= "boot-rescue-system-lvm"
WKS_SEARCH_PATH_prepend = "${TOPDIR}/../meta-hilscher-distro/files/part-schemes/${PART_SCHEME}:"
WKS_FILES_prepend =+ "hilscher-wic-image.wks.in"

HILSCHER_RESCUE_IMAGE ??= "hilscher-rescue-image"

HILSCHER_OVERLAY ??= "/dev/mapper/data-data"
HILSCHER_OVERLAYTARGETS ??= "rootfs"

##WIC_BOOT_PART_BASE_CONTENT ??= ""
WIC_BOOT_PART_EXTRA_CONTENT ??= "netx.rom;netx.rom"

##WIC_RESCUE_PART_BASE_CONTENT ??= "${HILSCHER_RESCUE_IMAGE_LINK_NAME}.squashfs"
WIC_RESCUE_PART_EXTRA_CONTENT ??= "rboot.cfg fitImage initrd-api-part-cfg;initrd-api"

##WIC_SYSTEM_PART_BASE_CONTENT ??= "${IMAGE_LINK_NAME}.squashfs"
WIC_SYSTEM_PART_EXTRA_CONTENT ??= "boot.cfg fitImage"

SWU_RSYNC_PART_UPDATE ??= "boot system"

##SWU_BOOT_PART_BASE_CONTENT ??= "${WIC_BOOT_PART_BASE_CONTENT}"
SWU_BOOT_PART_EXTRA_CONTENT ??= ""

##SWU_SYSTEM_PART_BASE_CONTENT ??= "${WIC_SYSTEM_PART_BASE_CONTENT}"
SWU_SYSTEM_PART_EXTRA_CONTENT ??= "nboot.cfg fitImage"

# Physical device of system partitions
PHYSICAL_SYSTEM_DEVICE ??= "/dev/mmcblk0"

# Size of boot partition
IMAGE_PART_BOOT_SIZE ??= "16M"

# Size of rescue partition
IMAGE_PART_RESCUE_SIZE ??= "128M"

# Size of system partition
IMAGE_PART_SYSTEM_SIZE ??= "2G"

# Size of data partition
IMAGE_PART_DATA_SIZE ??= "max"

# Size of logical volume "data" in userdata partition
PART_DATA_LV_DATA_SIZE ??= "60%VG"

# Size of logical volume "backup" in userdata partition
PART_DATA_LV_BACKUP_SIZE ??= "35%VG"

# Size of logical volume "snapshot" in userdata partition
PART_DATA_LV_SNAPSHOT_SIZE ??= "5%VG"
```

## meta-oem/conf/distro/netiot-oem.conf
```bitbake
require conf/distro/netiot.conf

DISTRO = "netiot-oem"
DISTRO_NAME = "netiot distro version used for oem overlay images."

DISTRO_EXTRA_RDEPENDS = ""
DISTRO_EXTRA_RRECOMMENDS = ""

INITRAMFS_IMAGE = ""

MACHINE_EXTRA_RDEPENDS = ""
MACHINE_EXTRA_RRECOMMENDS = ""

MACHINE_ESSENTIAL_EXTRA_RDEPENDS = ""
MACHINE_ESSENTIAL_EXTRA_RRECOMMENDS = ""

PREFERRED_PROVIDER_virtual/kernel = ""
PREFERRED_PROVIDER_virtual/dtb = ""
```
